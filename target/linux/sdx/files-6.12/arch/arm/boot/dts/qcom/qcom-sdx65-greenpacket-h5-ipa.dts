// SPDX-License-Identifier: BSD-3-Clause
#include "qcom-sdx65-greenpacket-h5-modem.dts"

&ipa {
	/* Stock boot firmware already enables GSI; do not load it a second time. */
	qcom,gsi-loader = "skip";
	interrupts-extended = <&intc GIC_SPI 241 IRQ_TYPE_LEVEL_HIGH>,
			      <&intc GIC_SPI 47 IRQ_TYPE_LEVEL_HIGH>,
			      <&ipa_smp2p_in 0 IRQ_TYPE_EDGE_RISING>,
			      <&ipa_smp2p_in 1 IRQ_TYPE_EDGE_RISING>;
	memory-region = <&ipa_fw_mem>;
	status = "okay";
};

&qpic_bam {
	status = "okay";
};

&qpic_nand {
	status = "okay";
	/* The stock msm_qpic_nand driver sets 100 MHz (MSM_NAND_BUS_VOTE_MAX_RATE).
	 * qcom_nandc only enables the RPMh clock, which leaves the minimum vote:
	 * raw reads measured 2.2 MB/s, versus 4.9 MB/s at 100 MHz.
	 */
	assigned-clocks = <&rpmhcc RPMH_QPIC_CLK>;
	assigned-clock-rates = <100000000>;

	nand@0 {
		reg = <0>;
		nand-ecc-strength = <4>;
		nand-ecc-step-size = <512>;
		nand-bus-width = <8>;
		/* Exact efs2 range from the verified H5 MIBIB backup. Access is
		 * blocked by the NAND core before any hardware read is issued.
		 */
		secure-regions = /bits/ 64 <0x380000 0x1600000>;
	};
};
